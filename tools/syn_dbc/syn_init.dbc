VERSION ""

NS_ :

BS_:

BU_: BCM EP

BO_ 512 SYN_MessageA: 8 EP
 SG_ State : 0|8@1+ (1,0) [0|255] ""  BCM
 SG_ Cnt : 8|8@1+ (1,0) [0|255] ""  BCM

BO_ 513 SYN_MessageB: 8 EP
 SG_ State : 0|8@1+ (1,0) [0|255] ""  BCM

BO_ 514 SYN_MessageC: 8 EP
 SG_ Raw : 0|8@1+ (1,0) [0|255] ""  BCM

BA_ "GenSigStartValue" SG_ 512 State 170;
BA_ "GenSigStartValue" SG_ 513 State 85;
CM_ SG_ 512 State "MessageA 的 State（初值 170）";
CM_ SG_ 513 State "MessageB 的 State（初值 85）";
